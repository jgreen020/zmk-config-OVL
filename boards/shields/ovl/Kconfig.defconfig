## boards/shields/ovl/Kconfig.defconfig
```kconfig
if SHIELD_OVL_LEFT

config ZMK_KEYBOARD_NAME
    default "OVL"

config ZMK_SPLIT_ROLE_CENTRAL
    default y

endif # SHIELD_OVL_LEFT

if SHIELD_OVL_LEFT || SHIELD_OVL_RIGHT

config ZMK_SPLIT
    default y

if ZMK_DISPLAY

config I2C
    default y

config SSD1306
    default y

endif # ZMK_DISPLAY


endif # SHIELD_OVL_LEFT || SHIELD_OVL_RIGHT
```

## boards/shields/ovl/Kconfig.shield
```kconfig
config SHIELD_OVL_LEFT
    def_bool $(shields_list_contains,ovl_left)

config SHIELD_OVL_RIGHT
    def_bool $(shields_list_contains,ovl_right)
```
